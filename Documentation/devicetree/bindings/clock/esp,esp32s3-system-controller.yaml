## Documentation/devicetree/bindings/pwm/esp,esp32s3-ledc.yaml
```yaml
# SPDX-License-Identifier: GPL-2.0-only
%YAML 1.2
---
$id: http://devicetree.org/schemas/pwm/esp,esp32s3-ledc.yaml#
$schema: http://devicetree.org/meta-schemas/core.yaml#

title: Espressif ESP32-S3 LED PWM controller

maintainers:
  - ESP32-S3 Linux project <noreply@example.invalid>

description: |
  The ESP32-S3 LEDC block provides eight low-speed PWM channels backed by
  four timers. Channels can use independent periods while a timer is free;
  channels sharing a timer must use the same period.

allOf:
  - $ref: pwm.yaml#

properties:
  compatible:
    const: esp,esp32s3-ledc

  reg:
    maxItems: 1

  clocks:
    maxItems: 1

  resets:
    maxItems: 1

  '#pwm-cells':
    const: 3

required:
  - compatible
  - reg
  - clocks
  - resets
  - '#pwm-cells'

additionalProperties: false

examples:
  - |
    pwm@60019000 {
        compatible = "esp,esp32s3-ledc";
        reg = <0x60019000 0x1000>;
        clocks = <&syscon 4>;
        resets = <&syscon 4>;
        #pwm-cells = <3>;
    };
```

## Documentation/devicetree/bindings/serial/esp,esp32s3-usb-serial-jtag.yaml
```yaml
# SPDX-License-Identifier: (GPL-2.0-only OR BSD-2-Clause)
%YAML 1.2
---
$id: http://devicetree.org/schemas/serial/esp,esp32s3-usb-serial-jtag.yaml#
$schema: http://devicetree.org/meta-schemas/core.yaml#

title: Espressif ESP32-S3 USB Serial/JTAG controller

maintainers:
  - Max Filippov <jcmvbkbc@gmail.com>

description: |
  The ESP32-S3 USB Serial/JTAG controller exposes a USB serial endpoint and a
  JTAG bridge. Linux uses the serial endpoint for early console and normal TTY
  operation. The ROM leaves the integrated USB PHY and device controller in a
  usable state; this node does not control the JTAG bridge or PHY routing.

allOf:
  - $ref: serial.yaml#

properties:
  compatible:
    const: esp,esp32s3-usb-serial-jtag

  reg:
    maxItems: 1

  interrupts:
    maxItems: 1

required:
  - compatible
  - reg
  - interrupts

unevaluatedProperties: false

examples:
  - |
    #include <dt-bindings/interrupt-controller/irq.h>

    serial@60038000 {
        compatible = "esp,esp32s3-usb-serial-jtag";
        reg = <0x60038000 0x1000>;
        interrupts = <96 IRQ_TYPE_LEVEL_HIGH>;
    };
```

## Documentation/devicetree/bindings/sound/esp,esp32s3-i2s.yaml
```yaml
# SPDX-License-Identifier: GPL-2.0-only
%YAML 1.2
---
$id: http://devicetree.org/schemas/sound/esp,esp32s3-i2s.yaml#
$schema: http://devicetree.org/meta-schemas/core.yaml#

title: ESP32-S3 I2S controller (ASoC CPU DAI)

maintainers:
  - ESP32-S3 Linux project <noreply@example.invalid>

description: |
  ESP32-S3 I2S controller exposed as an ASoC CPU DAI. PCM transfers use
  the ESP32-S3 GDMA dmaengine channels; the driver currently supports
  master mode with the Phillips (I2S) frame format and 2 channels. The
  Waveshare ESP32-S3-Touch-LCD-3.49 V2 connects MCLK to GPIO7, BCLK to
  GPIO15, WS to GPIO46, DSOUT to GPIO6 and DSDIN to GPIO45.

properties:
  compatible:
    const: esp,esp32s3-i2s

  reg:
    maxItems: 1

  clocks:
    items:
      - description: peripheral gate clock (syscon)
      - description: reference clock used for the divider math (160 MHz)

  clock-names:
    items:
      - const: gate
      - const: source

  resets:
    maxItems: 1

  dmas:
    items:
      - description: RX (capture) GDMA channel
      - description: TX (playback) GDMA channel

  dma-names:
    items:
      - const: rx
      - const: tx

  pinctrl-0: true
  pinctrl-names: true

  "#sound-dai-cells":
    const: 0

required:
  - compatible
  - reg
  - clocks
  - clock-names
  - resets
  - dmas
  - dma-names

unevaluatedProperties: false

examples:
  - |
    i2s0: i2s@6000f000 {
        compatible = "esp,esp32s3-i2s";
        reg = <0x6000f000 0x1000>;
        clocks = <&syscon 6>, <&i2s_160m>;
        clock-names = "gate", "source";
        resets = <&syscon 6>;
        dmas = <&gdma 3 0>, <&gdma 3 1>;
        dma-names = "rx", "tx";
        #sound-dai-cells = <0>;
    };
...
```

## Documentation/devicetree/bindings/sound/everest,es7210.yaml
```yaml
# SPDX-License-Identifier: GPL-2.0-only
%YAML 1.2
---
$id: http://devicetree.org/schemas/sound/everest,es7210.yaml#
$schema: http://devicetree.org/meta-schemas/core.yaml#

title: Everest ES7210 4-channel ADC codec

maintainers:
  - ESP32-S3 Linux project <noreply@example.invalid>

description: |
  Everest ES7210 4-channel audio ADC controlled over I2C. The 7-bit
  slave address is 0x40 when AD1/AD0 are both low. The codec consumes
  MCLK and I2S clocks from the SoC (clock consumer role). The Waveshare
  ESP32-S3-Touch-LCD-3.49 V2 wires it to I2C0 and the ESP32-S3 I2S0
  controller.

properties:
  compatible:
    const: everest,es7210

  reg:
    maxItems: 1

  clocks:
    items:
      - description: codec master clock (MCLK)

  clock-names:
    const: mclk

required:
  - compatible
  - reg
  - clocks
  - clock-names

unevaluatedProperties: false

examples:
  - |
    i2c {
        #address-cells = <1>;
        #size-cells = <0>;

        codec@40 {
            compatible = "everest,es7210";
            reg = <0x40>;
            clocks = <&codec_mclk>;
            clock-names = "mclk";
        };
    };
...
```

## Documentation/devicetree/bindings/sound/waveshare,esp32s3-audio.yaml
```yaml
# SPDX-License-Identifier: GPL-2.0-only
%YAML 1.2
---
$id: http://devicetree.org/schemas/sound/waveshare,esp32s3-audio.yaml#
$schema: http://devicetree.org/meta-schemas/core.yaml#

title: Waveshare ESP32-S3-Touch-LCD-3.49 V2 audio machine

maintainers:
  - ESP32-S3 Linux project <noreply@example.invalid>

description: |
  ASoC machine driver for the Waveshare ESP32-S3-Touch-LCD-3.49 V2
  audio chain: ES8311 codec playback and ES7210 ADC capture over the
  ESP32-S3 I2S0 controller, plus the NS4150B amplifier enable line.

properties:
  compatible:
    const: waveshare,esp32s3-audio

  pa-gpios:
    maxItems: 1
    description: NS4150B amplifier mode/enable line (TCA9554 EXIO7)

required:
  - compatible

unevaluatedProperties: false

examples:
  - |
    audio {
        compatible = "waveshare,esp32s3-audio";
        pa-gpios = <&tca9554 7 0>;
    };
...
```

## Documentation/devicetree/bindings/spi/esp,esp32s3-spi.yaml
```yaml
# SPDX-License-Identifier: GPL-2.0-only
%YAML 1.2
---
$id: http://devicetree.org/schemas/spi/esp,esp32s3-spi.yaml#
$schema: http://devicetree.org/meta-schemas/core.yaml#

title: Espressif ESP32-S3 general-purpose SPI controller

maintainers:
  - ESP32-S3 Linux project <noreply@example.invalid>

allOf:
  - $ref: spi-controller.yaml#

properties:
  compatible:
    const: esp,esp32s3-spi

  reg:
    maxItems: 1

  clocks:
    maxItems: 1

  resets:
    maxItems: 1

  interrupts:
    maxItems: 1

required:
  - compatible
  - reg
  - clocks
  - resets
  - interrupts

unevaluatedProperties: false

examples:
  - |
    #include <dt-bindings/clock/esp32s3.h>
    #include <dt-bindings/interrupt-controller/irq.h>
    #include <dt-bindings/reset/esp32s3.h>

    spi@60025000 {
        compatible = "esp,esp32s3-spi";
        reg = <0x60025000 0x1000>;
        clocks = <&syscon ESP32S3_CLK_SPI3>;
        resets = <&syscon ESP32S3_RST_SPI3>;
        interrupts = <22 IRQ_TYPE_LEVEL_HIGH>;
        #address-cells = <1>;
        #size-cells = <0>;
    };
```

## Documentation/devicetree/bindings/xtensa/cpus.yaml
```yaml
# SPDX-License-Identifier: (GPL-2.0-only OR BSD-2-Clause)
%YAML 1.2
---
$id: http://devicetree.org/schemas/xtensa/cpus.yaml#
$schema: http://devicetree.org/meta-schemas/core.yaml#

title: Xtensa CPUs

maintainers:
  - Max Filippov <jcmvbkbc@gmail.com>

allOf:
  - $ref: /schemas/cpu.yaml#

properties:
  compatible:
    const: cdns,xtensa-cpu

  device_type:
    const: cpu

  reg:
    maxItems: 1

  clocks:
    maxItems: 1

required:
  - compatible
  - device_type
  - reg

unevaluatedProperties: false

examples:
  - |
    cpu@0 {
        compatible = "cdns,xtensa-cpu";
        device_type = "cpu";
        reg = <0>;
    };
```

## Documentation/devicetree/bindings/xtensa/esp,esp32s3.yaml
```yaml
# SPDX-License-Identifier: (GPL-2.0-only OR BSD-2-Clause)
%YAML 1.2
---
$id: http://devicetree.org/schemas/xtensa/esp,esp32s3.yaml#
$schema: http://devicetree.org/meta-schemas/core.yaml#

title: Espressif ESP32-S3 based boards

maintainers:
  - Max Filippov <jcmvbkbc@gmail.com>

properties:
  $nodename:
    const: '/'

  compatible:
    oneOf:
      - description: Waveshare ESP32-S3-Touch-LCD-3.49 V2
        items:
          - const: waveshare,esp32-s3-touch-lcd-3.49-v2
          - const: esp,esp32s3

required:
  - compatible

additionalProperties: true

examples:
  - |
    / {
        model = "Waveshare ESP32-S3-Touch-LCD-3.49 V2";
        compatible = "waveshare,esp32-s3-touch-lcd-3.49-v2",
                     "esp,esp32s3";
    };
```

## sound/soc/esp32s3/Kconfig
```kconfig
# SPDX-License-Identifier: GPL-2.0-only
config SND_SOC_ESP32S3_I2S
	tristate "ESP32-S3 I2S controller ASoC CPU DAI"
	depends on SND_SOC
	select SND_SOC_GENERIC_DMAENGINE_PCM
	help
	  Say Y here to enable the ASoC CPU DAI for the ESP32-S3 I2S
	  controller. PCM transfers use the ESP32-S3 GDMA dmaengine
	  driver; the I2S controller runs in master mode with the
	  Phillips (I2S) frame format.

	  To compile this driver as a module, choose M here: the module
	  will be called i2s-esp32s3.

config SND_SOC_ESP32S3_I2S_KUNIT_TEST
	tristate "KUnit tests for the ESP32-S3 I2S driver" if !KUNIT_ALL_TESTS
	depends on KUNIT && SND_SOC_ESP32S3_I2S
	default KUNIT_ALL_TESTS
	help
	  Build pure-logic tests for the ESP32-S3 I2S clock divider
	  calculation. These tests run without ESP32-S3 hardware and do
	  not exercise any register access. If unsure, say N and run the
	  tests through the project's minimal UML KUnit configuration
	  instead.

config SND_SOC_ES7210
	tristate "Everest ES7210 4-ch ADC codec support"
	depends on I2C
	select REGMAP_I2C
	help
	  Say Y here to enable the Everest ES7210 4-channel ADC codec
	  driver. The Waveshare ESP32-S3-Touch-LCD-3.49 V2 wires it to
	  I2C0 address 0x40 and the ESP32-S3 I2S0 controller.

	  To compile this driver as a module, choose M here: the module
	  will be called es7210.

config SND_SOC_ES7210_KUNIT_TEST
	tristate "KUnit tests for the ES7210 codec" if !KUNIT_ALL_TESTS
	depends on KUNIT && SND_SOC_ES7210
	default KUNIT_ALL_TESTS
	help
	  Build pure-logic tests for the ES7210 clock coefficient table
	  transcription and lookup. These tests run without ES7210
	  hardware and do not exercise the I2C transfer path. If unsure,
	  say N and run the tests through the project's minimal UML KUnit
	  configuration instead.

config SND_SOC_ESP32S3_AUDIO
	tristate "Waveshare ESP32-S3-Touch-LCD-3.49 V2 ASoC machine driver"
	depends on SND_SOC_ESP32S3_I2S
	help
	  Say Y here to enable the ASoC machine driver for the Waveshare
	  ESP32-S3-Touch-LCD-3.49 V2 audio chain (ES8311 playback, ES7210
	  capture, NS4150B amplifier enable on TCA9554 EXIO7).

	  To compile this driver as a module, choose M here: the module
	  will be called esp32s3-audio.
```
