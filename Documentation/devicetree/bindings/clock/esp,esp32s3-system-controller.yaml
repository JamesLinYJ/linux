## Documentation/devicetree/bindings/clock/esp,esp32s3-system-controller.yaml
```yaml
# SPDX-License-Identifier: (GPL-2.0-only OR BSD-2-Clause)
%YAML 1.2
---
$id: http://devicetree.org/schemas/clock/esp,esp32s3-system-controller.yaml#
$schema: http://devicetree.org/meta-schemas/core.yaml#

title: Espressif ESP32-S3 system clock and reset controller

maintainers:
  - ESP32-S3 Linux project <noreply@example.invalid>

properties:
  compatible:
    const: esp,esp32s3-system-controller

  reg:
    maxItems: 1

  clocks:
    maxItems: 1

  '#clock-cells':
    const: 1

  '#reset-cells':
    const: 1

required:
  - compatible
  - reg
  - clocks
  - '#clock-cells'
  - '#reset-cells'

additionalProperties: false

examples:
  - |
    clock-controller@600c0000 {
        compatible = "esp,esp32s3-system-controller";
        reg = <0x600c0000 0x1000>;
        clocks = <&xtal>;
        #clock-cells = <1>;
        #reset-cells = <1>;
    };
```

## Documentation/devicetree/bindings/display/panel/axs,axs15231b.yaml
```yaml
# SPDX-License-Identifier: GPL-2.0-only
%YAML 1.2
---
$id: http://devicetree.org/schemas/display/panel/axs,axs15231b.yaml#
$schema: http://devicetree.org/meta-schemas/core.yaml#

title: AXS Technology AXS15231B 172x640 QSPI command-mode LCD panel

maintainers:
  - ESP32-S3 Linux project <noreply@example.invalid>

description: |
  The AXS15231B is a 172x640 in-cell touch LCD controller. In QSPI mode
  (hardware pin IM[3:0] strapped to 1010) the host drives the panel over
  quad SPI with a 4-byte single-line command phase in SPI mode 3. The
  Waveshare ESP32-S3-Touch-LCD-3.49 V2 connects it to SPI3 at 40 MHz with
  an active-low reset line on a TCA9554 I/O expander.

allOf:
  - $ref: panel-common.yaml#

properties:
  compatible:
    const: axs,axs15231b

  reg:
    maxItems: 1

  spi-max-frequency:
    maximum: 40000000

  spi-cpha: true
  spi-cpol: true

  reset-gpios:
    maxItems: 1
    description: active-low panel reset line

required:
  - compatible
  - reg
  - spi-max-frequency
  - spi-cpha
  - spi-cpol

unevaluatedProperties: false

examples:
  - |
    #include <dt-bindings/gpio/gpio.h>

    spi {
        #address-cells = <1>;
        #size-cells = <0>;

        panel@0 {
            compatible = "axs,axs15231b";
            reg = <0>;
            spi-max-frequency = <40000000>;
            spi-cpha;
            spi-cpol;
            reset-gpios = <&ioexpander 5 GPIO_ACTIVE_LOW>;
            backlight = <&lcd_backlight>;
        };
    };
...
```

## Documentation/devicetree/bindings/dma/esp,esp32s3-gdma.yaml
```yaml
# SPDX-License-Identifier: GPL-2.0-only
%YAML 1.2
---
$id: http://devicetree.org/schemas/dma/esp,esp32s3-gdma.yaml#
$schema: http://devicetree.org/meta-schemas/core.yaml#

title: Espressif ESP32-S3 general DMA controller

maintainers:
  - ESP32-S3 Linux project <noreply@example.invalid>

description:
  The ESP32-S3 GDMA controller has five pairs of independently routed receive
  and transmit channels. Hardware link descriptors must reside in internal
  DMA-capable SRAM, supplied through a dedicated shared DMA pool.

allOf:
  - $ref: dma-controller.yaml#

properties:
  compatible:
    const: esp,esp32s3-gdma

  reg:
    maxItems: 1

  clocks:
    maxItems: 1

  resets:
    maxItems: 1

  interrupts:
    minItems: 10
    maxItems: 10

  interrupt-names:
    items:
      - const: rx0
      - const: rx1
      - const: rx2
      - const: rx3
      - const: rx4
      - const: tx0
      - const: tx1
      - const: tx2
      - const: tx3
      - const: tx4

  memory-region:
    maxItems: 1
    description:
      Shared DMA pool in internal SRAM used exclusively for hardware link
      descriptors.

  dma-channels:
    const: 10

  dma-requests:
    const: 10

  '#dma-cells':
    const: 2
    description: |
      The first cell selects a peripheral trigger from
      dt-bindings/dma/esp32s3-gdma.h. The second cell selects RX or TX using
      ESP32S3_GDMA_DIR_RX or ESP32S3_GDMA_DIR_TX from the same header.

required:
  - compatible
  - reg
  - clocks
  - resets
  - interrupts
  - interrupt-names
  - memory-region
  - dma-channels
  - dma-requests
  - '#dma-cells'

unevaluatedProperties: false

examples:
  - |
    #include <dt-bindings/clock/esp32s3.h>
    #include <dt-bindings/interrupt-controller/irq.h>
    #include <dt-bindings/reset/esp32s3.h>

    reserved-memory {
        #address-cells = <1>;
        #size-cells = <1>;
        ranges;

        dma_pool: dma-pool@3fc88000 {
            compatible = "shared-dma-pool";
            reg = <0x3fc88000 0x8000>;
            no-map;
        };
    };

    dma-controller@6003f000 {
        compatible = "esp,esp32s3-gdma";
        reg = <0x6003f000 0x1000>;
        clocks = <&syscon ESP32S3_CLK_GDMA>;
        resets = <&syscon ESP32S3_RST_GDMA>;
        interrupts = <65 IRQ_TYPE_LEVEL_HIGH>,
                     <66 IRQ_TYPE_LEVEL_HIGH>,
                     <67 IRQ_TYPE_LEVEL_HIGH>,
                     <68 IRQ_TYPE_LEVEL_HIGH>,
                     <69 IRQ_TYPE_LEVEL_HIGH>,
                     <70 IRQ_TYPE_LEVEL_HIGH>,
                     <71 IRQ_TYPE_LEVEL_HIGH>,
                     <72 IRQ_TYPE_LEVEL_HIGH>,
                     <73 IRQ_TYPE_LEVEL_HIGH>,
                     <74 IRQ_TYPE_LEVEL_HIGH>;
        interrupt-names = "rx0", "rx1", "rx2", "rx3", "rx4",
                          "tx0", "tx1", "tx2", "tx3", "tx4";
        memory-region = <&dma_pool>;
        dma-channels = <10>;
        dma-requests = <10>;
        #dma-cells = <2>;
    };
```

## Documentation/devicetree/bindings/i2c/esp,esp32s3-i2c.yaml
```yaml
# SPDX-License-Identifier: GPL-2.0-only
%YAML 1.2
---
$id: http://devicetree.org/schemas/i2c/esp,esp32s3-i2c.yaml#
$schema: http://devicetree.org/meta-schemas/core.yaml#

title: Espressif ESP32-S3 I2C controller

maintainers:
  - ESP32-S3 Linux project <noreply@example.invalid>

allOf:
  - $ref: /schemas/i2c/i2c-controller.yaml#

properties:
  compatible:
    const: esp,esp32s3-i2c

  reg:
    maxItems: 1

  clocks:
    maxItems: 1

  resets:
    maxItems: 1

  interrupts:
    maxItems: 1

  clock-frequency:
    default: 100000
    minimum: 10000
    maximum: 1000000

required:
  - compatible
  - reg
  - clocks
  - resets
  - interrupts

unevaluatedProperties: false

examples:
  - |
    #include <dt-bindings/clock/esp32s3.h>
    #include <dt-bindings/interrupt-controller/irq.h>
    #include <dt-bindings/reset/esp32s3.h>

    i2c@60013000 {
        compatible = "esp,esp32s3-i2c";
        reg = <0x60013000 0x1000>;
        clocks = <&syscon ESP32S3_CLK_I2C0>;
        resets = <&syscon ESP32S3_RST_I2C0>;
        interrupts = <42 IRQ_TYPE_LEVEL_HIGH>;
        clock-frequency = <400000>;
        #address-cells = <1>;
        #size-cells = <0>;
    };
```

## Documentation/devicetree/bindings/iio/adc/esp,esp32s3-adc.yaml
```yaml
# SPDX-License-Identifier: GPL-2.0-only
%YAML 1.2
---
$id: http://devicetree.org/schemas/iio/adc/esp,esp32s3-adc.yaml#
$schema: http://devicetree.org/meta-schemas/core.yaml#

title: Espressif ESP32-S3 ADC1

maintainers:
  - ESP32-S3 Linux project <noreply@example.invalid>

description:
  The ESP32-S3 ADC1 provides ten single-ended channels on GPIO1 through
  GPIO10. This binding describes channels used with the RTC one-shot
  controller. Continuous conversions through the digital controller and
  GDMA are outside this binding.

properties:
  compatible:
    const: esp,esp32s3-adc

  reg:
    items:
      - description: SENS registers
      - description: Shared analog configuration registers

  reg-names:
    items:
      - const: sens
      - const: analog

  pinctrl-names:
    const: default

  pinctrl-0: true

  '#address-cells':
    const: 1

  '#size-cells':
    const: 0

  '#io-channel-cells':
    const: 1

patternProperties:
  '^channel@[0-9]$':
    $ref: adc.yaml

    properties:
      reg:
        minimum: 0
        maximum: 9

      esp,attenuation:
        $ref: /schemas/types.yaml#/definitions/uint32
        enum: [0, 1, 2, 3]
        description:
          Hardware attenuation encoding. Values 0, 1, 2 and 3 select
          approximately 0 dB, 2.5 dB, 6 dB and 12 dB respectively.

    required:
      - reg
      - esp,attenuation

    additionalProperties: false

required:
  - compatible
  - reg
  - reg-names
  - pinctrl-names
  - pinctrl-0
  - '#address-cells'
  - '#size-cells'
  - '#io-channel-cells'

additionalProperties: false

examples:
  - |
    adc@60008800 {
        compatible = "esp,esp32s3-adc";
        reg = <0x60008800 0x200>, <0x6000e000 0x100>;
        reg-names = "sens", "analog";
        pinctrl-names = "default";
        pinctrl-0 = <&adc1_channel3_pin>;
        #address-cells = <1>;
        #size-cells = <0>;
        #io-channel-cells = <1>;

        channel@3 {
            reg = <3>;
            esp,attenuation = <2>;
            label = "battery-divider";
        };
    };
```

## Documentation/devicetree/bindings/iio/imu/qst,qmi8658c.yaml
```yaml
# SPDX-License-Identifier: GPL-2.0-only
%YAML 1.2
---
$id: http://devicetree.org/schemas/iio/imu/qst,qmi8658c.yaml#
$schema: http://devicetree.org/meta-schemas/core.yaml#

title: QST QMI8658C 6-axis inertial measurement unit

maintainers:
  - ESP32-S3 Linux project <noreply@example.invalid>

description: |
  QST QMI8658C 6-axis IMU (3-axis accelerometer and 3-axis gyroscope)
  with an I2C interface. When SA0 is pulled up or left unconnected the
  7-bit slave address is 0x6A; pulling it down selects 0x6B. The
  Waveshare ESP32-S3-Touch-LCD-3.49 V2 wires INT1 to TCA9554 EXIO2 and
  INT2 to EXIO3.

properties:
  compatible:
    const: qst,qmi8658c

  reg:
    maxItems: 1

  interrupts:
    minItems: 1
    maxItems: 2
    description: |
      INT1 and INT2 interrupt lines, in that order. The driver currently
      polls the STATUS0 new-data flags and does not request these
      interrupts; they are reserved for the planned triggered-buffer
      support on INT2.

  drive-open-drain:
    type: boolean

required:
  - compatible
  - reg

unevaluatedProperties: false

examples:
  - |
    #include <dt-bindings/interrupt-controller/irq.h>

    i2c {
        #address-cells = <1>;
        #size-cells = <0>;

        imu@6a {
            compatible = "qst,qmi8658c";
            reg = <0x6a>;
            interrupt-parent = <&ioexpander>;
            interrupts = <2 IRQ_TYPE_EDGE_FALLING>,
                         <3 IRQ_TYPE_EDGE_FALLING>;
        };
    };
...
```

## Documentation/devicetree/bindings/input/touchscreen/axs,axs15231b.yaml
```yaml
# SPDX-License-Identifier: GPL-2.0-only
%YAML 1.2
---
$id: http://devicetree.org/schemas/input/touchscreen/axs,axs15231b.yaml#
$schema: http://devicetree.org/meta-schemas/core.yaml#

title: AXS Technology AXS15231B In-cell Touchscreen Controller

maintainers:
  - ESP32-S3 Linux project <noreply@example.invalid>

allOf:
  - $ref: touchscreen.yaml#

properties:
  compatible:
    const: axs,axs15231b

  reg:
    maxItems: 1

  interrupts:
    maxItems: 1

required:
  - compatible
  - reg
  - interrupts
  - touchscreen-size-x
  - touchscreen-size-y

unevaluatedProperties: false

examples:
  - |
    #include <dt-bindings/interrupt-controller/irq.h>

    i2c {
        #address-cells = <1>;
        #size-cells = <0>;

        touchscreen@3b {
            compatible = "axs,axs15231b";
            reg = <0x3b>;
            interrupt-parent = <&gpio_expander>;
            interrupts = <0 IRQ_TYPE_EDGE_FALLING>;
            touchscreen-size-x = <640>;
            touchscreen-size-y = <172>;
        };
    };
```

## Documentation/devicetree/bindings/interrupt-controller/esp,esp32s3-intc.yaml
```yaml
# SPDX-License-Identifier: (GPL-2.0-only OR BSD-2-Clause)
%YAML 1.2
---
$id: http://devicetree.org/schemas/interrupt-controller/esp,esp32s3-intc.yaml#
$schema: http://devicetree.org/meta-schemas/core.yaml#

title: Espressif ESP32-S3 peripheral interrupt matrix

maintainers:
  - Max Filippov <jcmvbkbc@gmail.com>

description: |
  The ESP32-S3 interrupt matrix routes 99 peripheral interrupt sources to
  the fixed interrupt inputs of either Xtensa CPU. The initial binding uses
  one level-triggered CPU0 interrupt as a chained parent. Each child specifier
  contains the peripheral source number followed by standard trigger flags.

allOf:
  - $ref: /schemas/interrupt-controller.yaml#

properties:
  compatible:
    const: esp,esp32s3-intc

  reg:
    maxItems: 1

  interrupts:
    description: CPU0 interrupt 2, a level-1 external Xtensa interrupt
    maxItems: 1

  interrupt-controller: true

  '#interrupt-cells':
    const: 2

required:
  - compatible
  - reg
  - interrupts
  - interrupt-controller
  - '#interrupt-cells'

additionalProperties: false

examples:
  - |
    #include <dt-bindings/interrupt-controller/irq.h>

    interrupt-controller@600c2000 {
        compatible = "esp,esp32s3-intc";
        reg = <0x600c2000 0x1000>;
        interrupt-parent = <&pic>;
        interrupts = <2 0>;
        interrupt-controller;
```

## Documentation/devicetree/bindings/pinctrl/esp,esp32s3-pinctrl.yaml
```yaml
# SPDX-License-Identifier: GPL-2.0-only
%YAML 1.2
---
$id: http://devicetree.org/schemas/pinctrl/esp,esp32s3-pinctrl.yaml#
$schema: http://devicetree.org/meta-schemas/core.yaml#

title: Espressif ESP32-S3 GPIO and pin controller

maintainers:
  - ESP32-S3 Linux project <noreply@example.invalid>

description:
  The ESP32-S3 GPIO block combines GPIO data and interrupt control with an
  I/O multiplexer and a matrix that routes peripheral signals to pads.

properties:
  compatible:
    const: esp,esp32s3-pinctrl

  reg:
    items:
      - description: GPIO and signal matrix registers
      - description: I/O multiplexer registers

  reg-names:
    items:
      - const: gpio
      - const: iomux

  gpio-controller: true

  '#gpio-cells':
    const: 2

  gpio-ranges:
    maxItems: 1

  gpio-reserved-ranges: true

  interrupt-controller: true

  '#interrupt-cells':
    const: 2

  interrupts:
    maxItems: 1

patternProperties:
  '-pins$':
    type: object
    allOf:
      - $ref: pinmux-node.yaml#
      - $ref: pincfg-node.yaml#

    properties:
      pins:
        items:
          pattern: '^gpio([0-9]|[1-3][0-9]|4[0-8])$'
          not:
            enum: [ gpio22, gpio23, gpio24, gpio25 ]

      function:
        enum:
          - gpio
          - i2c0-scl
          - i2c0-sda
          - i2c1-scl
          - i2c1-sda
          - spi3-clk
          - spi3-cs0
          - spi3-d
          - spi3-hd
          - spi3-q
          - spi3-wp

      bias-disable: true
      bias-pull-up: true
      bias-pull-down: true
      drive-open-drain: true
      drive-push-pull: true
      input-enable: true
      input-disable: true

    required:
      - pins
      - function

    additionalProperties: false

required:
  - compatible
  - reg
  - reg-names
  - gpio-controller
  - '#gpio-cells'
  - gpio-ranges
  - interrupt-controller
  - '#interrupt-cells'
  - interrupts

additionalProperties: false

examples:
  - |
    #include <dt-bindings/interrupt-controller/irq.h>

    pinctrl: pinctrl@60004000 {
        compatible = "esp,esp32s3-pinctrl";
        reg = <0x60004000 0x700>, <0x60009000 0x100>;
        reg-names = "gpio", "iomux";
        interrupt-parent = <&intc>;
        interrupts = <16 IRQ_TYPE_LEVEL_HIGH>;
        gpio-controller;
        #gpio-cells = <2>;
        gpio-ranges = <&pinctrl 0 0 49>;
        interrupt-controller;
        #interrupt-cells = <2>;

        i2c0-pins {
            pins = "gpio47", "gpio48";
            function = "gpio";
            bias-pull-up;
            drive-open-drain;
            input-enable;
        };
    };
```
